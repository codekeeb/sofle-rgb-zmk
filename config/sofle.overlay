// Se aplica a ambas mitades. Define el behavior que usa el módulo
// claude-usage como canal de datos central -> periférico; el nombre del
// nodo ("claude_usage") es la cadena que viaja por el enlace split y
// debe tener menos de 16 caracteres.

/ {
    behaviors {
        claude_usage: claude_usage {
            compatible = "qolera,claude-usage";
            #binding-cells = <2>;
        };
    };
};
