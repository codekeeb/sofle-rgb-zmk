// Se aplica a ambas mitades. OJO: ZMK solo busca en el config overlays
// llamados <shield_completo>.overlay (p.ej. sofle_left.overlay),
// <board>.overlay o default.overlay — "sofle.overlay" NO se carga.

/ {
    behaviors {
        // Canal de datos central -> periférico del módulo claude-usage.
        // OJO: el nombre del nodo viaja por el enlace split BLE y su payload
        // solo admite 8 caracteres + nulo (ZMK_SPLIT_RUN_BEHAVIOR_DEV_LEN=9);
        // con un nombre más largo la central lo trunca y el periférico no
        // encuentra el behavior (falla en silencio).
        cldusage: cldusage {
            compatible = "qolera,claude-usage";
            #binding-cells = <2>;
        };

        // Alterna la pantalla del widget (reposo del bicho <-> datos).
        // Se usa en el keymap como &clddisp (vía tap-dance en DEL).
        clddisp: clddisp {
            compatible = "qolera,claude-disp";
            #binding-cells = <0>;
        };
    };
};
