## dts/bindings/behaviors/zmk,behavior-oled-notify.yaml
```yaml
# SPDX-License-Identifier: MIT

description: Internal split relay carrying a notice for the right screen (not for keymaps)

compatible: "zmk,behavior-oled-notify"

include: one_param.yaml
```

## dts/bindings/behaviors/zmk,behavior-sleep-cfg.yaml
```yaml
# SPDX-License-Identifier: MIT
description: Relay interno del ajuste de deep sleep (activado + minutos)

compatible: "zmk,behavior-sleep-cfg"

include: two_param.yaml
```

## dts/bindings/rgb-fx-base.yaml
```yaml
# Copyright (c) 2024 Kuba Birecki
# SPDX-License-Identifier: MIT

properties:
  display-name:
    type: string
    description: |
      Short name shown on the peripheral screen when the effect is picked
      (at most 8 letters fit the Sofle's OLED).

  pixels:
    type: array
    required: true
    description: |
      Pixel positions to which the RGB effects should apply.

  blending-mode:
    type: string
    enum:
      - "normal"
      - "multiply"
      - "lighten"
      - "darken"
      - "screen"
      - "subtract"
    default: "normal"
    description: |
      Blending mode for the effects to use during render.
```

## dts/bindings/zmk,rgb-fx-matrix.yaml
```yaml
# Copyright (c) 2026 CodeKeeb
# SPDX-License-Identifier: MIT

description: |
  Digital rain: drops with a bright head and a fading trail fall down the
  key columns. Follows the global rotation, hue and speed.

compatible: "zmk,rgb-fx-matrix"

include: rgb-fx-base.yaml

properties:
  color:
    type: int
    required: true
    description: |
      Trail color in HSL format.

  head-color:
    type: int
    required: true
    description: |
      Color of the leading drop in HSL format, usually a lighter tint.

  trail:
    type: int
    default: 55
    description: |
      Length of the trail in position units (a key is about 19).

  column-width:
    type: int
    default: 19
    description: |
      Pixels closer than this across the fall direction share a column.
```
